## Documentation/devicetree/bindings/input/touchscreen/himax,hx83112b.yaml
```yaml
# SPDX-License-Identifier: (GPL-2.0-only OR BSD-2-Clause)
%YAML 1.2
---
$id: http://devicetree.org/schemas/input/touchscreen/himax,hx83112b.yaml#
$schema: http://devicetree.org/meta-schemas/core.yaml#

title: Himax HX83100A/HX83112B touchscreen controller

maintainers:
  - Job Noorman <job@noorman.info>

description: |
  These parts are touch-and-display driver integration (TDDI) controllers: the
  same die drives the display and the touch panel, and both halves are fed from
  the panel's rails. The display half is described by
  bindings/display/panel/himax,hx83112a.yaml and
  bindings/display/panel/himax,hx83112b.yaml, which require iovcc-supply among
  others. The touch half needs the same I/O rail, so it has to hold its own
  reference to it - otherwise the panel driver's vote is the only one, and the
  touch controller loses its supply whenever the display is powered down while
  the touch driver still believes the device is reachable.

allOf:
  - $ref: touchscreen.yaml#

properties:
  compatible:
    enum:
      - himax,hx83100a
      - himax,hx83112b

  reg:
    maxItems: 1

  interrupts:
    maxItems: 1

  reset-gpios:
    maxItems: 1
    description: External reset (XRES), active low

  iovcc-supply:
    description:
      I/O voltage rail, shared with the display half of the same controller.

  vdda-supply:
    description: Analog voltage rail.

  touchscreen-inverted-x: true
  touchscreen-inverted-y: true
  touchscreen-size-x: true
  touchscreen-size-y: true
  touchscreen-swapped-x-y: true

required:
  - compatible
  - reg
  - interrupts
  - reset-gpios

unevaluatedProperties: false

examples:
  - |
    #include <dt-bindings/gpio/gpio.h>
    #include <dt-bindings/interrupt-controller/irq.h>

    i2c {
        #address-cells = <1>;
        #size-cells = <0>;

        touchscreen@48 {
            compatible = "himax,hx83112b";
            reg = <0x48>;
            interrupt-parent = <&tlmm>;
            interrupts = <65 IRQ_TYPE_LEVEL_LOW>;
            reset-gpios = <&tlmm 64 GPIO_ACTIVE_LOW>;
            iovcc-supply = <&pm8953_l6>;
            vdda-supply = <&pm8953_l10>;
            touchscreen-size-x = <1080>;
            touchscreen-size-y = <2160>;
        };
    };
```

## Documentation/devicetree/bindings/media/i2c/onnn,lc898217xc.yaml
```yaml
# SPDX-License-Identifier: (GPL-2.0-only OR BSD-2-Clause)
%YAML 1.2
---
$id: http://devicetree.org/schemas/media/i2c/onnn,lc898217xc.yaml#
$schema: http://devicetree.org/meta-schemas/core.yaml#

title: ON Semiconductor LC898217 voice coil lens actuator

maintainers:
  - Laszlo Gergely Lajoshazi <lajoshazilg@gmail.com>

description:
  LC898217 is a voice coil motor (VCM) camera lens actuator that is
  controlled over I2C.

properties:
  compatible:
    enum:
      - onnn,lc898217xc

  reg:
    maxItems: 1

  vaf-supply:
    description: Actuator (VCM driver) supply

  vio-supply:
    description:
      I/O supply. It is shared with the camera sensor on the modules the
      actuator ships in, and the actuator does not answer on I2C unless it
      is on; the driver enables it for the whole time the actuator is
      powered so the sensor going down does not take the bus with it.

required:
  - compatible
  - reg
  - vaf-supply
  - vio-supply

additionalProperties: false

examples:
  - |
    i2c {
        #address-cells = <1>;
        #size-cells = <0>;

        camera-lens@72 {
            compatible = "onnn,lc898217xc";
            reg = <0x72>;

            vaf-supply = <&vreg_cam_af_2p85>;
            vio-supply = <&vreg_cam_io_1p8>;
        };
    };

...
```

## Documentation/devicetree/bindings/media/i2c/samsung,s5k4h7.yaml
```yaml
# SPDX-License-Identifier: (GPL-2.0-only OR BSD-2-Clause)
%YAML 1.2
---
$id: http://devicetree.org/schemas/media/i2c/samsung,s5k4h7.yaml#
$schema: http://devicetree.org/meta-schemas/core.yaml#

title: Samsung S5K4H7 8 Mpixel CMOS Digital Image Sensor

maintainers:
  - Lajosházi, László Gergely <lajoshazilg@gmail.com>

description:
  S5K4H7 is an 8 Mpixel CMOS image sensor with a pixel array of 3264 x 2448.
  It is programmable through an I2C interface and sends image data over
  MIPI CSI-2.

$ref: /schemas/media/video-interface-devices.yaml#

properties:
  compatible:
    const: samsung,s5k4h7

  reg:
    maxItems: 1

  clocks:
    description: Master clock (MCLK), 24 MHz.
    maxItems: 1

  reset-gpios:
    description:
      Reference to the GPIO connected to the reset pin, which is active low.
    maxItems: 1

  vdda-supply:
    description: Analog voltage supply, 2.8 V

  vddio-supply:
    description: Interface voltage supply, 1.8 V

  vddd-supply:
    description: Digital core voltage supply, 1.2 V

  port:
    $ref: /schemas/graph.yaml#/$defs/port-base
    additionalProperties: false

    properties:
      endpoint:
        $ref: /schemas/media/video-interfaces.yaml#
        unevaluatedProperties: false

        properties:
          data-lanes: true
          link-frequencies: true

        required:
          - data-lanes

    required:
      - endpoint

required:
  - compatible
  - reg
  - clocks
  - vdda-supply
  - vddio-supply
  - vddd-supply

unevaluatedProperties: false

examples:
  - |
    #include <dt-bindings/gpio/gpio.h>

    i2c {
        #address-cells = <1>;
        #size-cells = <0>;

        camera@10 {
            compatible = "samsung,s5k4h7";
            reg = <0x10>;

            clocks = <&camera_clk>;

            reset-gpios = <&tlmm 129 GPIO_ACTIVE_LOW>;

            vdda-supply = <&vreg_cam_analog_2p8>;
            vddio-supply = <&vreg_cam_io_1p8>;
            vddd-supply = <&vreg_cam2_dig_1p2>;

            orientation = <0>;
            rotation = <270>;
        };
    };
```

## Documentation/devicetree/bindings/media/i2c/sony,imx363.yaml
```yaml
# SPDX-License-Identifier: (GPL-2.0-only OR BSD-2-Clause)
%YAML 1.2
---
$id: http://devicetree.org/schemas/media/i2c/sony,imx363.yaml#
$schema: http://devicetree.org/meta-schemas/core.yaml#

title: Sony IMX363 12 Mpixel CMOS Digital Image Sensor

maintainers:
  - Lajosházi, László Gergely <lajoshazilg@gmail.com>

description:
  IMX363 is a diagonal 7.06 mm (Type 1/2.55) 12 Mpixel CMOS active pixel type
  stacked image sensor with a square pixel array of 4032 x 3024. It is
  programmable through an I2C interface, and sends image data over MIPI CSI-2
  on two or four lanes.

$ref: /schemas/media/video-interface-devices.yaml#

properties:
  compatible:
    const: sony,imx363

  reg:
    maxItems: 1

  clocks:
    description: Input clock (INCK), 6 to 27 MHz.
    maxItems: 1

  clock-frequency:
    description:
      Frequency the sensor is told to run its input clock at. The driver
      applies it with clk_set_rate(), so it must match what the clock provider
      can produce.

  reset-gpios:
    description:
      Reference to the GPIO connected to the XCLR pin, if any.
    maxItems: 1

  vana-supply:
    description: Analog voltage (VANA) supply, 2.8 V

  vdig-supply:
    description: Digital core voltage (VDIG) supply, 1.2 V

  vif-supply:
    description: Interface voltage (VIF) supply, 1.8 V

  port:
    $ref: /schemas/graph.yaml#/$defs/port-base
    additionalProperties: false

    properties:
      endpoint:
        $ref: /schemas/media/video-interfaces.yaml#
        unevaluatedProperties: false

        properties:
          data-lanes:
            description:
              The sensor runs in a two-lane or a four-lane mode, chosen from
              the number of entries here. The lane numbering itself is not
              significant to this device.
            oneOf:
              - minItems: 2
                maxItems: 2
              - minItems: 4
                maxItems: 4

          link-frequencies: true

        required:
          - data-lanes
          - link-frequencies

    required:
      - endpoint

required:
  - compatible
  - reg
  - clocks
  - vana-supply
  - vdig-supply
  - vif-supply
  - port

unevaluatedProperties: false

examples:
  - |
    #include <dt-bindings/gpio/gpio.h>

    i2c {
        #address-cells = <1>;
        #size-cells = <0>;

        camera@1a {
            compatible = "sony,imx363";
            reg = <0x1a>;

            clocks = <&camera_clk>;
            clock-frequency = <24000000>;

            reset-gpios = <&tlmm 40 GPIO_ACTIVE_HIGH>;

            vana-supply = <&vreg_cam_analog_2p8>;
            vdig-supply = <&vreg_cam_core_1p2>;
            vif-supply = <&vreg_cam_io_1p8>;

            orientation = <1>;
            rotation = <270>;

            port {
                endpoint {
                    remote-endpoint = <&csiphy0_ep>;
                    data-lanes = <0 1 2 3>;
                    link-frequencies = /bits/ 64 <636000000 321000000>;
                };
            };
        };
    };
```

## Documentation/devicetree/bindings/sound/qcom,wcd9335.yaml
```yaml
# SPDX-License-Identifier: GPL-2.0-only OR BSD-2-Clause
%YAML 1.2
---
$id: http://devicetree.org/schemas/sound/qcom,wcd9335.yaml#
$schema: http://devicetree.org/meta-schemas/core.yaml#

title: Qualcomm WCD9335 Audio Codec

maintainers:
  - Srinivas Kandagatla <srinivas.kandagatla@linaro.org>

description:
  Qualcomm WCD9335 Codec is a standalone Hi-Fi audio codec IC with in-built
  Soundwire controller and interrupt mux. It supports both I2S/I2C and SLIMbus
  audio interfaces.

properties:
  compatible:
    const: slim217,1a0

  reg:
    maxItems: 1

  clocks:
    maxItems: 2

  clock-names:
    items:
      - const: mclk
      - const: slimbus

  interrupts:
    maxItems: 2

  interrupt-names:
    items:
      - const: intr1
      - const: intr2

  interrupt-controller: true

  '#interrupt-cells':
    const: 1

  reset-gpios:
    maxItems: 1

  slim-ifc-dev:
    description: SLIM IFC device interface
    $ref: /schemas/types.yaml#/definitions/phandle

  '#sound-dai-cells':
    const: 1

  vdd-buck-supply:
    description: 1.8V buck supply

  vdd-buck-sido-supply:
    description: 1.8V SIDO buck supply

  vdd-io-supply:
    description: 1.8V I/O supply

  vdd-micbias-supply:
    description: micbias supply

  vdd-rx-supply:
    description: 1.8V rx supply

  vdd-tx-supply:
    description: 1.8V tx supply

  vdd-vbat-supply:
    description: vbat supply

  qcom,micbias1-microvolt:
    description: micbias1 voltage
    minimum: 1800000
    maximum: 2850000

  qcom,micbias2-microvolt:
    description: micbias2 voltage
    minimum: 1800000
    maximum: 2850000

  qcom,micbias3-microvolt:
    description: micbias3 voltage
    minimum: 1800000
    maximum: 2850000

  qcom,micbias4-microvolt:
    description: micbias4 voltage
    minimum: 1800000
    maximum: 2850000

  qcom,dmic-sample-rate:
    description:
      Clock rate of the digital microphones, in Hz. The codec derives it
      from mclk with a divider of 2, 3, 4, 6, 8 or 16, so only those
      fractions of the mclk rate can be expressed.
    $ref: /schemas/types.yaml#/definitions/uint32

  qcom,mbhc-buttons-vthreshold-microvolt:
    description:
      Array of 8 voltage threshold values corresponding to headset
      button0 - button7. Omitting it disables button detection.
    minItems: 8
    maxItems: 8

  qcom,hphl-jack-type-normally-open:
    type: boolean
    description:
      True if the HPHL pin on the jack is NO (Normally Open), false if it's
      NC (Normally Closed).

  qcom,gnd-jack-type-normally-open:
    type: boolean
    description:
      True if the GND pin on the jack is NO (Normally Open), false if it's
      NC (Normally Closed).

required:
  - compatible
  - reg

allOf:
  - $ref: dai-common.yaml#
  - if:
      required:
        - slim-ifc-dev
    then:
      required:
        - clocks
        - clock-names
        - interrupts
        - interrupt-names
        - interrupt-controller
        - '#interrupt-cells'
        - reset-gpios
        - slim-ifc-dev
        - '#sound-dai-cells'
        - vdd-buck-supply
        - vdd-buck-sido-supply
        - vdd-io-supply
        - vdd-rx-supply
        - vdd-tx-supply
    else:
      properties:
        clocks: false
        clock-names: false
        interrupts: false
        interrupt-names: false
        interrupt-controller: false
        '#interrupt-cells': false
        reset-gpios: false
        slim-ifc-dev: false
        '#sound-dai-cells': false
        vdd-buck-supply: false
        vdd-buck-sido-supply: false
        vdd-io-supply: false
        vdd-micbias-supply: false
        vdd-rx-supply: false
        vdd-tx-supply: false
        vdd-vbat-supply: false
        qcom,micbias1-microvolt: false
        qcom,micbias2-microvolt: false
        qcom,micbias3-microvolt: false
        qcom,micbias4-microvolt: false
        qcom,dmic-sample-rate: false
        qcom,mbhc-buttons-vthreshold-microvolt: false
        qcom,hphl-jack-type-normally-open: false
        qcom,gnd-jack-type-normally-open: false

additionalProperties: false

examples:
  - |
    #include <dt-bindings/clock/qcom,rpmcc.h>
    #include <dt-bindings/gpio/gpio.h>
    #include <dt-bindings/interrupt-controller/irq.h>

    tasha_ifd: codec@0,0 {
        compatible = "slim217,1a0";
        reg = <0 0>;
    };

    codec@1,0 {
        compatible = "slim217,1a0";
        reg = <1 0>;

        clock-names = "mclk", "slimbus";
        clocks = <&div1_mclk>, <&rpmcc RPM_SMD_BB_CLK1>;

        interrupt-parent = <&tlmm>;
        interrupts = <54 IRQ_TYPE_LEVEL_HIGH>,
                     <53 IRQ_TYPE_LEVEL_HIGH>;
        interrupt-names = "intr1", "intr2";
        interrupt-controller;
        #interrupt-cells = <1>;

        reset-gpios = <&tlmm 64 GPIO_ACTIVE_LOW>;
        slim-ifc-dev = <&tasha_ifd>;
        #sound-dai-cells = <1>;

        vdd-buck-supply = <&vreg_s4a_1p8>;
        vdd-buck-sido-supply = <&vreg_s4a_1p8>;
        vdd-tx-supply = <&vreg_s4a_1p8>;
        vdd-rx-supply = <&vreg_s4a_1p8>;
        vdd-io-supply = <&vreg_s4a_1p8>;
    };
```
